#include <dt-bindings/zmk/matrix_transform.h>

/ {
    chosen {
        zmk,kscan = &default_kscan;
        zmk,matrix_transform = &default_transform;
    };

    default_kscan: kscan {
        compatible = "zmk,kscan-gpio-matrix";
        label = "default_kscan";
        diode-direction = "col2row";

        row-gpios
            = <&gpio0 9 (GPIO_ACTIVE_HIGH | GPIO_PULL_DOWN)>
            , <&gpio0 10 (GPIO_ACTIVE_HIGH | GPIO_PULL_DOWN)>
            , <&gpio1 6 (GPIO_ACTIVE_HIGH | GPIO_PULL_DOWN)>
            , <&gpio0 25 (GPIO_ACTIVE_HIGH | GPIO_PULL_DOWN)>
            , <&gpio0 5 (GPIO_ACTIVE_HIGH | GPIO_PULL_DOWN)>
            , <&gpio1 15 (GPIO_ACTIVE_HIGH | GPIO_PULL_DOWN)>
            , <&gpio0 2 (GPIO_ACTIVE_HIGH | GPIO_PULL_DOWN)>
            , <&gpio01 11 (GPIO_ACTIVE_HIGH | GPIO_PULL_DOWN)>
            , <&gpio 8 (GPIO_ACTIVE_HIGH | GPIO_PULL_DOWN)>
            ;

        col-gpios
            = <&gpio0 12 GPIO_ACTIVE_HIGH>
            , <&gpio0 13 GPIO_ACTIVE_HIGH>
            , <&gpio1 1 GPIO_ACTIVE_HIGH>
            , <&gpio0 29 GPIO_ACTIVE_HIGH>
            , <&gpio1 13 GPIO_ACTIVE_HIGH>
            , <&gpio0 6 GPIO_ACTIVE_HIGH>
            , <&gpio0 8 GPIO_ACTIVE_HIGH>
            , <&gpio1 0 GPIO_ACTIVE_HIGH>
            , <&gpio1 10 GPIO_ACTIVE_HIGH>
            , <&gpio1 2 GPIO_ACTIVE_HIGH>
            , <&gpio1 4 GPIO_ACTIVE_HIGH>
            , <&gpio0 13 GPIO_ACTIVE_HIGH>
            , <&gpio0 15 GPIO_ACTIVE_HIGH>
            , <&gpio0 17 GPIO_ACTIVE_HIGH>
            ;
    };
    default_transform: keymap_transform_0 {
        compatible = "zmk,matrix-transform";
        columns = <9>;
        rows = <14>;
        map = <

        R(0,0)   R(0,1)   R(0,2)   R(0,3)   R(0,4)   R(0,5)   R(0,6)   R(0,7)   R(0,8)
        R(1,0)   R(1,1)   R(1,2)   R(1,3)   R(1,4)   R(1,5)   R(1,6)   R(1,7)   R(1,8)
        R(2,0)   R(2,1)   R(2,2)   R(2,3)   R(2,4)   R(2,5)   R(2,6)   R(2,7)   R(2,8)
        R(3,0)   R(3,1)   R(3,2)   R(3,3)   R(3,4)   R(3,5)   R(3,6)   R(3,7)   R(3,8)
        R(4,0)   R(4,1)   R(4,2)   R(4,3)   R(4,4)   R(4,5)   R(4,6)   R(4,7)   R(4,8)
        R(5,0)   R(5,1)   R(5,2)   R(5,3)   R(5,4)   R(5,5)   R(5,6)   R(5,7)   R(5,8)
        R(6,0)   R(6,1)   R(6,2)   R(6,3)   R(6,4)   R(6,5)   R(6,6)   R(6,7)   R(6,8)
        R(7,0)   R(7,1)   R(7,2)   R(7,3)   R(7,4)   R(7,5)   R(7,6)   R(7,7)   R(7,8)
        R(8,0)   R(8,1)   R(8,2)   R(8,3)   R(8,4)   R(8,5)   R(8,6)   R(8,7)   R(8,8)
        R(9,0)   R(9,1)   R(9,2)   R(9,3)   R(9,4)   R(9,5)   R(9,6)   R(9,7)   R(9,8)
        R(10,0)  R(10,1)  R(10,2)  R(10,3)  R(10,4)  R(10,5)  R(10,6)  R(10,7)  R(10,8)
        R(11,0)  R(11,1)  R(11,2)  R(11,3)  R(11,4)  R(11,5)  R(11,6)  R(11,7)  R(11,8)
        R(12,0)  R(12,1)  R(12,2)  R(12,3)  R(12,4)  R(12,5)  R(12,6)  R(12,7)  R(12,8)
        R(13,0)  R(13,1)  R(13,2)  R(13,3)  R(13,4)  R(13,5)  R(13,6)  R(13,7)  R(13,8)
        >;
    };
};